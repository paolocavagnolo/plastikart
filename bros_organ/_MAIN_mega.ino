#define aPin 26 //5
#define bPin 28 //6
#define cPin 30 //7
#define dPin 32 //8
#define ePin 34 //9
#define fPin 36 //1
#define gPin 38 //2
#define hPin 40 //3
#define iPin 42 //4 - 

#define lightPin 44
#define audioPin 50

#define remoteBtn A9
#define playBtn A8
#define dmxPin 9

uint16_t aOn[] = {1834, 2413, 3136, 11377, 11955, 12822, 20919, 22943, 24389, 26813, 26837, 26862, 26886,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 28364, 28380};
uint16_t aOff[] = {1907, 2485, 3208, 11653, 12231, 13098, 21479, 23521, 24971, 26821, 26845, 26870, 26895,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 28372, 28389};
uint16_t bOn[] = {100, 678, 1256, 1834, 2413, 3136, 3569, 4148, 4726, 5883, 7039, 8196, 9353,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 28348, 28372};
uint16_t bOff[] = {172, 750, 1329, 1907, 2485, 3208, 3642, 4220, 5291, 6448, 7605, 8761, 9918,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 28356, 28380};
uint16_t cOn[] = {2196, 12533, 20630, 20919, 21786, 22943, 24389, 26829, 26854, 26878, 26903, 26927, 26952,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 28356, 28380};
uint16_t cOff[] = {2268, 12809, 20649, 21479, 21808, 23521, 24971, 26837, 26862, 26886, 26911, 26936, 26960,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 28364, 28389};
uint16_t dOn[] = {9786, 10509, 11955, 13112, 14268, 14557, 14846, 15280, 16003, 17738, 18606, 20630, 23425,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 28364, 28380};
uint16_t dOff[] = {9931, 11363, 12231, 13677, 14296, 14586, 14875, 15309, 16873, 18028, 19476, 20649, 23528,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 28372, 28389};
uint16_t eOn[] = {8630, 11377, 12244, 13690, 17232, 20340, 23232, 24389, 26418, 26829, 26845, 26862, 26878,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 28356, 28372};
uint16_t eOff[] = {8919, 11653, 12520, 14051, 17739, 20360, 23437, 24971, 26813, 26837, 26854, 26870, 26886,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 28364, 28380};
uint16_t fOn[] = {4726, 7039, 7618, 8196, 9353, 12533, 12822, 13112, 14268, 14557, 14846, 15280, 16003,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 28364, 28380};
uint16_t fOff[] = {5291, 7473, 7907, 8485, 9786, 12809, 13098, 13677, 14296, 14586, 14875, 15309, 16873,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 28372, 28389};
uint16_t gOn[] = {10509, 11955, 13112, 16003, 18606, 20919, 21497, 21786, 22365, 22955, 22973, 22991, 23009,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 28356, 28380};
uint16_t gOff[] = {11363, 12231, 13677, 16873, 19476, 21479, 21642, 21808, 22943, 22961, 22979, 22997, 23015,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 28364, 28389};
uint16_t hOn[] = {12244, 12822, 16003, 18606, 21497, 21786, 22365, 22949, 22967, 22985, 23003, 23021, 23039,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 28348, 28372};
uint16_t hOff[] = {12520, 13098, 16873, 19476, 21642, 21808, 22943, 22955, 22973, 22991, 23009, 23027, 23045,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 28356, 52480};
uint16_t iOn[] = {11377, 12533, 13112, 16003, 18606, 20340, 20919, 21497, 22365, 22943, 22961, 22979, 22997,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 28364, 28380};
uint16_t iOff[] = {11653, 12809, 13677, 16873, 19476, 20360, 21479, 21642, 22943, 22949, 22967, 22985, 23003,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 28372, 28389};

uint8_t i_aLen = 74;
uint8_t i_bLen = 87;
uint8_t i_cLen = 71;
uint8_t i_dLen = 65;
uint8_t i_eLen = 104;
uint8_t i_fLen = 69;
uint8_t i_gLen = 106;
uint8_t i_hLen = 105;
uint8_t i_iLen = 107;


uint8_t i_aon = 0;
uint8_t i_aoff = 0;
uint8_t i_bon = 0;
uint8_t i_boff = 0;
uint8_t i_con = 0;
uint8_t i_coff = 0;
uint8_t i_don = 0;
uint8_t i_doff = 0;
uint8_t i_eon = 0;
uint8_t i_eoff = 0;
uint8_t i_fon = 0;
uint8_t i_foff = 0;
uint8_t i_gon = 0;
uint8_t i_goff = 0;
uint8_t i_hon = 0;
uint8_t i_hoff = 0;
uint8_t i_ion = 0;
uint8_t i_ioff = 0;


bool aState = false;
bool bState = false;
bool cState = false;
bool dState = false;
bool eState = false;
bool fState = false;
bool gState = false;
bool hState = false;
bool iState = false;


void setup() {
  
  pinMode(lightPin,OUTPUT);
  digitalWrite(lightPin,HIGH);
  pinMode(audioPin,OUTPUT);
  digitalWrite(audioPin,LOW);

  pinMode(remoteBtn,INPUT_PULLUP);
  pinMode(playBtn,INPUT_PULLUP);
  pinMode(dmxPin,INPUT_PULLUP);

  for (uint8_t i=48;i>25;i=i-2) {
    pinMode(i,OUTPUT);
    digitalWrite(i,HIGH);
  }

//  Serial.begin(9600);
}

unsigned long t = 0;
unsigned long tt = 0;

bool play = false;

bool first = true;

bool tCont = true;
bool erCont = false;
unsigned long tC = 0;

void loop() {

  if (!digitalRead(playBtn)) {
    
    
    //SEL SU PLAY
    if (first) {
      
      delay(200);
      tC = millis();
    
      while(tCont) {
        if (digitalRead(playBtn)) {
          tCont = false;
          erCont = true;
        }
        if ((millis() - tC) > 200) {
          tCont = false;
          erCont = false;
        }
      }

      if (!erCont) {
        play = true;
        digitalWrite(audioPin,HIGH);
        digitalWrite(lightPin,LOW);
        t = millis();
        first = false;
        tCont = true;
      }
    }
    
  }

  else if (digitalRead(remoteBtn)) {
    //SEL SU REMOTE
    if (digitalRead(dmxPin)) {
      if (first) {
        play = true;
        digitalWrite(audioPin,HIGH);
        digitalWrite(lightPin,LOW);
        t = millis();
        first = false;
        tCont = true;
        
      }
    }
    else {
      while(tCont) {
        if (digitalRead(playBtn)) {
          tCont = false;
          erCont = true;
        }
        if ((millis() - tC) > 200) {
          tCont = false;
          erCont = false;
        }
      }

      if (!erCont) {
        _idle();
      }
      
    }
  }
  else {
    //SEL SU MANUALE
    _idle();
    digitalWrite(audioPin,LOW);
    
  }

  if (play) {
    tt = (millis() - t)/10;

    //AAA
    if ((i_aon) < i_aLen) { 
      if ((tt > aOn[i_aon]) && (!aState)){
        digitalWrite(aPin,LOW);
        i_aon++;
        aState = true;
        //Serial.println("A_ON");
      }
    }
    if ((i_aoff) < i_aLen) { 
      if ((tt > aOff[i_aoff]) && (aState)) {
        digitalWrite(aPin,HIGH);
        i_aoff++;
        aState = false;
        //Serial.println("A_OFF");
      }
    }
    // BBB-2
    if ((i_bon) < i_bLen) { 
      if ((tt > bOn[i_bon]) && (!bState)){
        digitalWrite(bPin,LOW);
        i_bon++;
        bState = true;
        //Serial.println("B_ON");
      }
    }
    if ((i_boff) < i_bLen) { 
      if ((tt > bOff[i_boff]) && (bState)) {
        digitalWrite(bPin,HIGH);
        i_boff++;
        bState = false;
        //Serial.println("B_OFF");
      }
    }

    // CCC-3
    if ((i_con) < i_cLen) { 
      if ((tt > cOn[i_con]) && (!cState)){
        digitalWrite(cPin,LOW);
        i_con++;
        cState = true;
        //Serial.println("C_ON");
      }
    }
    if ((i_coff) < i_cLen) { 
      if ((tt > cOff[i_coff]) && (cState)) {
        digitalWrite(cPin,HIGH);
        i_coff++;
        cState = false;
        //Serial.println("C_OFF");
      }
    }
    // DDD-4
    if ((i_don) < i_dLen) { 
      if ((tt > dOn[i_don]) && (!dState)){
        digitalWrite(dPin,LOW);
        i_don++;
        dState = true;
        //Serial.println("D_ON");
      }
    }
    if ((i_doff) < i_dLen) { 
      if ((tt > dOff[i_doff]) && (dState)) {
        digitalWrite(dPin,HIGH);
        i_doff++;
        dState = false;
        //Serial.println("D_OFF");
      }
    }

    // EEE-5
    if ((i_eon) < i_eLen) { 
      if ((tt > eOn[i_eon]) && (!eState)){
        digitalWrite(ePin,LOW);
        i_eon++;
        eState = true;
        //Serial.println("E_ON");
      }
    }
    if ((i_eoff) < i_eLen) { 
      if ((tt > eOff[i_eoff]) && (eState)) {
        digitalWrite(ePin,HIGH);
        i_eoff++;
        eState = false;
        //Serial.println("E_OFF");
      }
    }

    // FFF-6
    if ((i_fon) < i_fLen) { 
      if ((tt > fOn[i_fon]) && (!fState)){
        digitalWrite(fPin,LOW);
        i_fon++;
        fState = true;
        //Serial.println("F_ON");
      }
    }
    if ((i_foff) < i_fLen) { 
      if ((tt > fOff[i_foff]) && (fState)) {
        digitalWrite(fPin,HIGH);
        i_foff++;
        fState = false;
        //Serial.println("F_OFF");
      }
    }

    // GGG-7
    if ((i_gon) < i_gLen) { 
      if ((tt > gOn[i_gon]) && (!gState)){
        digitalWrite(gPin,LOW);
        i_gon++;
        gState = true;
        //Serial.println("G_ON");
      }
    }
    if ((i_goff) < i_gLen) { 
      if ((tt > gOff[i_goff]) && (gState)) {
        digitalWrite(gPin,HIGH);
        i_goff++;
        gState = false;
        //Serial.println("G_OFF");
      }
    }
    
    // HHH-8
    if ((i_hon) < i_hLen) { 
      if ((tt > hOn[i_hon]) && (!hState)){
        digitalWrite(hPin,LOW);
        i_hon++;
        hState = true;
        //Serial.println("H_ON");
      }
    }
    if ((i_hoff) < i_hLen) { 
      if ((tt > hOff[i_hoff]) && (hState)) {
        digitalWrite(hPin,HIGH);
        i_hoff++;
        hState = false;
        //Serial.println("H_OFF");
      }
    }
 
    // III-9
    if ((i_ion) < i_iLen) { 
      if ((tt > iOn[i_ion]) && (!iState)){
        digitalWrite(iPin,LOW);
        i_ion++;
        iState = true;
        //Serial.println("I_ON");
      }
    }
    if ((i_ioff) < i_iLen) { 
      if ((tt > iOff[i_ioff]) && (iState)) {
        digitalWrite(iPin,HIGH);
        i_ioff++;
        iState = false;
        //Serial.println("I_OFF");
      }
    }

  }
  
}

void _idle() {

  aState = false;
  bState = false;
  cState = false;
  dState = false;
  eState = false;
  fState = false;
  gState = false;
  hState = false;
  iState = false;

  i_aon = 0;
  i_aoff = 0;
  i_bon = 0;
  i_boff = 0;
  i_con = 0;
  i_coff = 0;
  i_don = 0;
  i_doff = 0;
  i_eon = 0;
  i_eoff = 0;
  i_fon = 0;
  i_foff = 0;
  i_gon = 0;
  i_goff = 0;
  i_hon = 0;
  i_hoff = 0;
  i_ion = 0;
  i_ioff = 0;

  tCont = true;
  erCont = false;

  play = false;
  digitalWrite(lightPin, HIGH);
  first = true;

  for (uint8_t i=48;i>25;i=i-2) {
    pinMode(i,OUTPUT);
    digitalWrite(i,HIGH);
  }

  
}
